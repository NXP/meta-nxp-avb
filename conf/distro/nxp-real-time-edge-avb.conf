## conf/distro/nxp-real-time-edge-avb.conf
```bitbake
require conf/distro/nxp-real-time-edge.conf

DISTRO = "nxp-real-time-edge-avb"

DISTRO_FEATURES:append = " real-time-edge-avb"
DISTROOVERRIDES .= ":real-time-edge-avb"
```

## conf/layer.conf
```bitbake
# We have a conf and classes directory, add to BBPATH
BBPATH .= ":${LAYERDIR}"

# We have recipes-* directories, add to BBFILES
BBFILES += "${LAYERDIR}/recipes-*/*/*.bb \
            ${LAYERDIR}/recipes-*/*/*.bbappend"

BBFILE_COLLECTIONS += "meta-nxp-avb"
BBFILE_PATTERN_meta-nxp-avb = "^${LAYERDIR}/"
BBFILE_PRIORITY_meta-nxp-avb = "10"
LAYERSERIES_COMPAT_meta-nxp-avb = "mickledore"


REAL_TIME_EDGE_AVB_DEVICETREE ?= ""
REAL_TIME_EDGE_AVB_DEVICETREE:imx6ull14x14evk = "imx6ull-14x14-evk-avb.dtb imx6ull-14x14-evk-avb-mcr.dtb"
REAL_TIME_EDGE_AVB_DEVICETREE:imx8mm-lpddr4-evk = "freescale/imx8mm-evk-avb.dtb"
REAL_TIME_EDGE_AVB_DEVICETREE:imx8mp-lpddr4-evk = "freescale/imx8mp-evk-avb.dtb"
REAL_TIME_EDGE_AVB_DEVICETREE:imx93evk = "freescale/imx93-11x11-evk-avb.dtb"
REAL_TIME_EDGE_AVB_DEVICETREE:imx93-14x14-lpddr4x-evk = "freescale/imx93-14x14-evk-aud-hat-avb.dtb freescale/imx93-14x14-evk-sja1105-avb.dtb"
REAL_TIME_EDGE_AVB_DEVICETREE:imx8dxlb0-lpddr4-evk = "freescale/imx8dxl-evk-enet0-avb.dtb freescale/imx8dxl-evk-enet0-tja1100-avb.dtb freescale/imx8dxl-evk-enet0-sja1105.dtb"

KERNEL_DEVICETREE:append:real-time-edge = " ${REAL_TIME_EDGE_AVB_DEVICETREE}"
```
